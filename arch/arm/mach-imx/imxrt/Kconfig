## arch/arm/mach-imx/imxrt/Kconfig
```kconfig
if ARCH_IMXRT

config IMXRT1020
	bool

config IMXRT1050
	bool

config SYS_SOC
	default "imxrt"

choice
	prompt "NXP i.MXRT board select"
	optional

config TARGET_IMXRT1050_EVK
	bool "Support imxrt1050 EVK board"
	select IMXRT1050

endchoice

source "board/freescale/imxrt1050-evk/Kconfig"

endif
```
